VERSION "x"
BO_ 256 M: 8 ECU
 SG_ A : 0|16@1+ (1,0) [0|1] "" TCU
 SG_ B : 8|16@1+ (1,0) [0|1] "" TCU
